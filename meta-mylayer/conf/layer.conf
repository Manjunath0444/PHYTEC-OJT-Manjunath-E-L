## meta-mylayer/conf/layer.conf
```bitbake
# We have a conf and classes directory, add to BBPATH
BBPATH .= ":${LAYERDIR}"

# We have recipes-* directories, add to BBFILES
BBFILES += "${LAYERDIR}/recipes-*/*/*.bb ${LAYERDIR}/recipes-*/*/*.bbappend"

BBFILE_COLLECTIONS += "mylayer"
BBFILE_PATTERN_mylayer = "^${LAYERDIR}/"
BBFILE_PRIORITY_mylayer = "1"

# This should only be incremented on significant changes that will
# cause compatibility issues with other layers
LAYERVERSION_mylayer = "1"

LAYERDEPENDS_mylayer = "core"

LAYERSERIES_COMPAT_mylayer = "kirkstone"
```
